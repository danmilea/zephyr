## boards/arm64/qemu_cortex_a53/Kconfig.defconfig
```kconfig
# Copyright (c) 2019 Carlo Caione <ccaione@baylibre.com>
# SPDX-License-Identifier: Apache-2.0

if BOARD_QEMU_CORTEX_A53

config BUILD_OUTPUT_BIN
	default y

config BOARD
	default "qemu_cortex_a53"

if NETWORKING

config NET_L2_ETHERNET
        default y

endif #NETWORKING

endif # BOARD_QEMU_CORTEX_A53
```

## drivers/virtio/Kconfig
```kconfig
#VIRTIO drivers configuration options

#Copyright (c) 2021 Wind River Systems, Inc.
# SPDX-License-Identifier: Apache-2.0

menuconfig VIRTIO
	bool "VIRTIO Drivers"

if VIRTIO

config VIRTIO_MMIO
	bool "Support VIRTIO MMIO transport"
	help
	  Enable support for VIRTIO over MMIO

config VIRTIO_SERIAL
	bool "Support VIRTIO Console device"
	select SERIAL_HAS_DRIVER
	select SERIAL_SUPPORT_INTERRUPT
	select RING_BUFFER
	help
	  Enable support for VIRTIO Console (serial) device

config VIRTIO_NETWORK
	bool "Support VIRTIO Network device"
	help
	  Enable support for VIRTIO Network device

if VIRTIO_NETWORK

#TODO: if virtio-pci is ever supported, we need some parameter to enable
#the correct virtio-net model here
config ETH_NIC_MODEL
        string
        default "virtio-net-device"
        help
          Tells what Qemu network model to use. This value is given as
          a parameter to -nic qemu command line option.

endif #VIRTIO_NETWORK

endif #VIRTIO
```

## dts/bindings/virtio/virtio,mmio.yaml
```yaml
description: VIRTIO MMIO bindings
compatible: "virtio,mmio"

include: base.yaml

bus: virtio

properties:
    reg:
      required: true
    interrupts:
      required: true
    dma-coherent:
      type: boolean
    memory-region:
      type: phandle
      required: false
      default: &sram0
    driver-mode:
      type: boolean
      required: false

interrupt-cells:
  - type
  - irq
  - flags
  - priority
```
