## CMakeLists.txt
```
# SPDX-License-Identifier: Apache-2.0

cmake_minimum_required(VERSION 3.13.1)

list(APPEND QEMU_EXTRA_FLAGS -device virtio-serial-device)
list(APPEND QEMU_EXTRA_FLAGS -chardev socket,path=/tmp/foo,server=on,wait=off,id=foo)
list(APPEND QEMU_EXTRA_FLAGS -device virtconsole,chardev=foo)

find_package(Zephyr REQUIRED HINTS $ENV{ZEPHYR_BASE})
project(hello_world)
zephyr_compile_definitions(METAL_MAX_DEVICE_REGIONS=2)

target_sources(app PRIVATE src/main.c)
```

## prj.conf
```kconfig
CONFIG_VIRTIO=y
CONFIG_VIRTIO_MMIO=y
CONFIG_VIRTIO_SERIAL=y
CONFIG_BOOT_BANNER=n
CONFIG_EARLY_CONSOLE=y
CONFIG_UART_INTERRUPT_DRIVEN=n
CONFIG_SHELL=y
CONFIG_SHELL_BACKEND_SERIAL_INTERRUPT_DRIVEN=n
CONFIG_SHELL_BACKEND_SERIAL_INIT_PRIORITY=0
CONFIG_OPENAMP=y
CONFIG_LIBMETAL=y
CONFIG_HEAP_MEM_POOL_SIZE=131072
```

## boards/qemu_cortex_a53.overlay
```dts
/{
	virtio_mmio@a003e00 {
		status = "okay";
		label = "virtio0";
		memory-region = <&sram0>;
		virtio0: serial {
		label = "virt-serial";
		compatible = "virtio-serial";
		};
	};

	chosen {
		zephyr,console = &virtio0;
		zephyr,shell-uart = &virtio0;
	};

};
```

## src/main.c
```c
/*
 * Copyright (c) 2012-2014 Wind River Systems, Inc.
 *
 * SPDX-License-Identifier: Apache-2.0
 */

#include <zephyr/kernel.h>
#include <zephyr/sys/printk.h>
#include <zephyr/init.h>
#include <metal/device.h>

int main(void)
{
	printk("Hello World! %s\n", CONFIG_BOARD);
	return 0;
}

#define PRINTK_TEST(level) \
int _test_##level()\
{\
	printk("%s()\n",__FUNCTION__);\
	return 0;\
}\
SYS_INIT(_test_##level,level, 99);

int init_metal()
{
	int32_t err;
	struct metal_init_params metal_params = METAL_INIT_DEFAULTS;
	metal_params.log_level = METAL_LOG_DEBUG;

	err = metal_init(&metal_params);
	if (err) {
		metal_log(METAL_LOG_ERROR, "metal_init: failed - error code %d\n", err);
		return -ENODEV;
	}

	return 0;
}
SYS_INIT(init_metal, PRE_KERNEL_1, 49);

PRINTK_TEST(PRE_KERNEL_1)
PRINTK_TEST(PRE_KERNEL_2)
PRINTK_TEST(POST_KERNEL)
PRINTK_TEST(APPLICATION)

void printk_timer_expired(struct k_timer *timer)
{
	printk("%s()\n",__FUNCTION__);
}

K_TIMER_DEFINE(printk_test_timer, printk_timer_expired, NULL);

int printk_timer_start()
{
	k_timer_start(& printk_test_timer, K_MSEC(10), K_SECONDS(10));
	return 0;
}

SYS_INIT(printk_timer_start,PRE_KERNEL_1, 99);
```
